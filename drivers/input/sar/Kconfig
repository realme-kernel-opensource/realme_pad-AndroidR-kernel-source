## drivers/input/sar/Kconfig
```kconfig
#
# Input sar senaor device configuration
#

config INPUT_SAR_SENSOR
    bool "input sar sensor"
	depends on INPUT
	---help---
	  Set Y here and a list of supported sar sensor will be displayed;
	  
source "drivers/input/sar/AW9610X/Kconfig"
```

## drivers/input/touchscreen/oppo_touchscreen/Himax/hx83102e_noflash/Kconfig
```kconfig
config TOUCHPANEL_HIMAX_HX83102E_NOFLASH
#	default y
	bool "TP himax hx83102e no-flash IC enable or not for OPPO"
	---help---
	say Y to enable driver for Touchpanel useing himax hx83102e no-flash
```

## drivers/input/touchscreen/oppo_touchscreen/Novatek/Kconfig
```kconfig
config TOUCHPANEL_NT_DIGITALNOISE_TEST
#   default y
    bool "TP nova nt36523B IC add digital noise test or not for OPPO"
    ---help---
    say Y to add digital noise test

source "drivers/input/touchscreen/oppo_touchscreen/Novatek/NT36523_noflash/Kconfig"
```

## drivers/misc/mediatek/sensors-1.0/situation/sar/Kconfig
```kconfig
config MTK_SAR_HUB
	bool "sarthub for MediaTek package"
	default n
	help
	  A sar is a device,
	  usually portable and electronic
	  or electromechanical,
	  that detect distance between the body and device .

config MTK_AP_SAR
	bool "AP SAR for MediaTek package"
	default n
	help
	  Say Y to use AP sar.
	  if N here to use HUB sar.

config SAR_AW9610X
	tristate "Awinic AW9610X_Sar driver"
	depends on I2C
	help
	  Say Y here if you have Awinic AW9610X_Sar controller
	  chip in your system.
	  If unsure, say N.
	  To compile this driver as a module, choose M here: the
	  module will be called AW9610X_Sar key.
```

## drivers/power/Kconfig
```kconfig
source "drivers/power/avs/Kconfig"
source "drivers/power/reset/Kconfig"
source "drivers/power/supply/Kconfig"

source "drivers/power/oplus/Kconfig"

config OPLUS_CHARGER_MT6370_TYPEC
	bool "OPLUS_CHARGER"
	default n
	help
	  Set Yes to support OPLUS_CHARGER_MT6370_TYPEC features
	  smart battery.
	  Set No to disable OPLUS_CHARGER_MT6370_TYPEC features
	  smart battery.

config OPLUS_CHARGER
	bool "OPLUS_CHARGER"
	default n
	help
	  Set Yes to support OPLUS_CHARGER features
	  smart battery.
	  Set No to disable OPLUS_CHARGER features
	  smart battery.

config OPLUS_CHARGER_MTK
	bool "OPLUS charger on MTK"
	default n
	help
	  Say Yes here to declare charging system is on MTK
	  Say No here to declare charging system is not on MTK

config OPLUS_CHARGER_MTK_CHGIC
	bool "OPLUS_CHARGER_MTK_CHG_IC"
	default n
	help
	  Say Yes to use MTK platform charger ic
	  Say No to use extern charger ic


config OPLUS_CHARGER_MTK6769
	bool "OPLUS_CHARGER_MTK6769"
	default n
	help
	  Set yes to support OPLUS_CHARGER_MTK6769 features
	  smart battery.
	  Set No to disable OPLUS_CHARGER_MTK6769 features

config OPLUS_HVDCP_SUPPORT
        bool "OPLUS_HVDCP_SUPPORT"
        default n
        help
          Set yes to support hvdcp.

config OPLUS_CHECK_CHARGERID_VOLT
	bool "OPLUS_CHECK_CHARGERID_VOLT"
	default n
	help
	  Set yes to support OPLUS_CHECK_CHARGERID_VOLT features
	  smart battery.
	  Set No to disable OPLUS_CHECK_CHARGERID_VOLT features
	  smart battery.

config OPLUS_4400MV_BATTERY_SUPPORT
	bool "OPLUS_CHECK_CHARGERID_VOLT"
	default n
	help
	  Set yes to support BATTERYID features
	  smart battery.
	  Set No to disable BATTERYID features
	  smart battery.

config OPLUS_CALL_MODE_SUPPORT
	bool "OPLUS call mode support"
	default n
	help
	  Say Y to enable support for the oplus call mode.

config MTK_ADDITIONAL_BATTERY_TABLE
	bool "OPLUS_CHARGER_ZCV"
	default n
	help
	  Set yes to support BATTERY_ZCV features
	  smart battery.
	  Set No to disable BATTERY_ZCV features
	  smart battery.


config OPLUS_SHIP_MODE_SUPPORT
	bool "OPLUS ship mode support"
	default n
	help
	  Say Y to include support

config OPLUS_SHORT_HW_CHECK
	bool "OPLUS batt HW SHORT"
	default n
	help
	  Say Y to include support

config OPLUS_SMART_CHARGER_SUPPORT
        bool "OPLUS Smart Charger support"
        default n
        help
          Say Y to include support

config OPLUS_DUAL_CHARGER_SUPPORT
	bool "OPLUS Dual Charger support"
	default n
	help
	  Say Y to include support

config OPLUS_SHORT_IC_CHECK
	bool "OPLUS batt short "
	help
	  Say Y here to declare charging system is on MTK

config OPLUS_FAST2NORMAL_CHG
	bool "OPLUS FAST2NORMAL CHG STATUS"
	help
	  Say Y to include support

config OPLUS_DUAL_BQ_CHARGER
	bool "OPLUS DOUBLE BQ CHG CONG"
	default n
	help
	  Say Y to include support
```

## drivers/soc/oppo/Kconfig
```kconfig
#ifdef OPLUS_FEATURE_TP_BASIC
# Bin.Li@EXP.BSP.bootloader.bootflow, 2017/05/15, Add for config oppo software common soft
config OPPO_ARCH_FILE
    bool "for build directory oppo"
    ---help---
    say Y to buid in
source "drivers/soc/oppo/oppo_devinfo/Kconfig"

#endif /* OPLUS_FEATURE_MEMLEAK_DETECT */
```
